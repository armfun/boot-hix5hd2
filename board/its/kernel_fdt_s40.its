## board/its/kernel_fdt_s40.its
```
/*
 * Simple U-boot uImage source file containing a single kernel and FDT blob
 */

/dts-v1/;

/ {
	description = "S40 single zImage and multi FDT blobs";
	#address-cells = <1>;

	images {
		kernel@1 {
			description = "S40 Linux kernel";
			data = /incbin/("./zImage");
			type = "kernel_noload";
			arch = "arm";
			os = "linux";
			compression = "none";
			load = <0>;
			entry = <0>;
			hash@1 {
				algo = "crc32";
			};
			hash@2 {
				algo = "sha1";
			};
		};
		fdt@1 {
			description = "S40 Flattened Device Tree blob";
			data = /incbin/("./s40.dtb");
			type = "flat_dt";
			arch = "arm";
			compression = "none";
			hash@1 {
				algo = "crc32";
			};
			hash@2 {
				algo = "sha1";
			};
		};
		fdt@2 {
			description = "3716M Flattened Device Tree blob";
			data = /incbin/("./hi3716M.dtb");
			type = "flat_dt";
			arch = "arm";
			compression = "none";
			hash@1 {
				algo = "crc32";
			};
			hash@2 {
				algo = "sha1";
			};
		};
	};

	configurations {
		default = "conf@1";
		conf@1 {
			description = "Boot Linux kernel with S40 FDT blob";
			kernel = "kernel@1";
			fdt = "fdt@1";
		};
		conf@2 {
			description = "Boot Linux kernel with 3716M FDT blob";
			kernel = "kernel@1";
			fdt = "fdt@2";
		};
	};
};
```
